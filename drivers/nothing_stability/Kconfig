## drivers/nothing_stability/Kconfig
```kconfig
config NOTHING_SECURE_ELEMENT
	tristate "Nothing secure state"
	default n
	help
		This driver getting secure info from hw which setting up in early stage.
```
